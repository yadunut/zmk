## app/boards/shields/nutboard/Kconfig.defconfig
```kconfig
if SHIELD_NUTBOARD_LEFT
  config ZMK_KEYBOARD_NAME
    default "Nutboard Left"
  config ZMK_SPLIT_BLE_ROLE_CENTRAL
    default y
endif

if SHIELD_NUTBOARD_RIGHT
  config ZMK_KEYBOARD_NAME
    default "Nutboard Right"
endif

if SHIELD_NUTBOARD_LEFT || SHIELD_NUTBOARD_RIGHT
  config ZMK_SPLIT
    default y
endif
```

## app/boards/shields/nutboard/Kconfig.shield
```kconfig
config SHIELD_NUTBOARD_LEFT
	def_bool $(shields_list_contains,nutboard_left)
config SHIELD_NUTBOARD_RIGHT
	def_bool $(shields_list_contains,nutboard_right)
```
